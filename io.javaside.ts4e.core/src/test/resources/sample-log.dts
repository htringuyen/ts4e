/* https://github.com/zephyrproject-rtos/zephyr/blob/master/dts/arm/armv6-m.dtsi */
/* Hello-World */

#include "skeleton.dtsi"

/ {
	soc {
		#address-cells = <1>;
		#size-cells = <1>;
		compatible = "simple-bus";
		interrupt-parent = <&nvic>;
		ranges;

		nvic: interrupt-controller@e000e100  {
			compatible = "arm,v6m-nvic";
			reg = <0xe000e100 0xc00>;
			interrupt-controller;
			#interrupt-cells = <2>;
		};

		systick: timer@e000e010 {
			compatible = "arm,armv6m-systick";
			reg = <0xe000e010 0x10>;
		};
	};
};

---
startBytes = 83 + 2 + 3 = 88
newEndBytes = 83 + 2 + 11 = 96
startPoint = (1, 3)
newEndPoint = (1, 14)

---
/* https://github.com/zephyrproject-rtos/zephyr/blob/master/dts/arm/armv6-m.dtsi */
/* SPDX-License-Identifier: Apache-2.0 */

#include "skeleton.dtsi"

/ {
	soc {
		#address-cells = <1>;
		#size-cells = <1>;
		compatible = "simple-bus";
		interrupt-parent = <&nvic>;
		ranges;

		nvic: interrupt-controller@e000e100  {
			compatible = "arm,v6m-nvic";
			reg = <0xe000e100 0xc00>;
			interrupt-controller;
			#interrupt-cells = <2>;
		};

		systick: timer@e000e010 {
			compatible = "arm,armv6m-systick";
			reg = <0xe000e010 0x10>;
		};
	};
};

----
startBytes = 83 + 2 + 3 = 88
oldEndBytes = 83 + 2 + 3 + 35 = 123
startPoint = (1, 3)
oldEndPoint = (1, 38)